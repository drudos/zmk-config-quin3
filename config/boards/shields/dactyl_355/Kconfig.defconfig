## config/boards/shields/dactyl_355/Kconfig.defconfig
```kconfig
# Copyright (c) 2020 Pete Johanson, Kurtis Lew
# SPDX-License-Identifier: MIT

if SHIELD_DACTYL_355_LEFT

config ZMK_KEYBOARD_NAME
    default "Dactyl_355"

config ZMK_SPLIT_ROLE_CENTRAL
    default y

endif

if SHIELD_DACTYL_355_LEFT || SHIELD_DACTYL_355_RIGHT

config ZMK_SPLIT
    default y

endif
```

## config/boards/shields/dactyl_355/Kconfig.shield
```kconfig
config SHIELD_DACTYL_355_LEFT
    def_bool $(shields_list_contains,dactyl_355_left)

config SHIELD_DACTYL_355_RIGHT
    def_bool $(shields_list_contains,dactyl_355_right)
```
